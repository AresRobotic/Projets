# CY8C4125AXI_483 register map
File version: 0.1
PSoC 4100
Registers are 32-bit, read-write, no defined reset value unless marked. A register's access mark holds for its fields unless they carry their own. Offsets are from the block's base; lines under a group give offsets from that group; [hi:lo] are bit positions; {n}, {i} and the like mark numbered series; 'fields as' and 'values as' point back to an identical list; <NAME> marks a mode.

## Memory map
0x40050108 PWM_1 size 0x11
0x40050148 PWM_3 size 0x11
0x40050188 TIM_4 size 0x11
0x400501C8 PWM_2 size 0x11

## TIM_4
Base 0x40050188
Same registers: PWM_1 0x40050108, PWM_3 0x40050148, PWM_2 0x400501C8
0x00 COUNTER — Current counter value
0x04 CC — Compare / capture value
0x08 CC_BUF — Compare / capture buffer value
0x0C PERIOD — Period value
0x10 PERIOD_BUF — Period buffer value
